/**
 * State logic for changing the LCD's contrast. Includes a "gradient" bitmap for better visibility.
 */

// Actual lcd initialization can be found in Nokia5110-Display.ino
extern Nokia_LCD lcd;

// Encoder initialization can be found in Encoder.ino
extern ESP32Encoder encoder;

// Encoder button initialization can be found in Encoder.ino
extern volatile boolean encoder_button_pressed;

// Bitmap to display on the lcd. It covers the half Nokia5110 Display and shows a "gradient"
// from black to white
const unsigned char CONTRAST_ADJUSTMENT_GRADIENT[252] PROGMEM = {
0xFF, 0xFF, 0xFF, 0xFF, 0xFF, 0xFF, 0xFF, 0xFF, 0xFF, 0xFF, 0xFF, 0xFF, 0xFF, 0xFF, 0xFF, 0xFF,
0xFF, 0xFF, 0xFF, 0xFF, 0xDF, 0xFF, 0xFF, 0xFF, 0xFF, 0xFF, 0xFF, 0xDD, 0xBD, 0xFA, 0xFF, 0xFB,
0xE3, 0xFF, 0x3F, 0xFF, 0xF7, 0xFF, 0xFF, 0x37, 0x7F, 0xFF, 0xFF, 0xE4, 0xFE, 0xDC, 0xDF, 0xF7,
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0x36, 0x10, 0x02, 0x00, 0x10, 0x00, 0x02, 0x00, 0x00, 0x00, 0x00, 0x00, 
};

/**
 * Process user input to adjust contrast value and finaly store the new value on state exit.
 */
void menu_change_contrast_state_logic() {
  // process inputs
  if (encoder_button_pressed) {
    uint8_t new_contrast_value = menu_change_contrast_backlight_state | menu_change_contrast_current_value;
    EEPROM.write(EEPROM_LCD_BL_CONTRAST_POS, new_contrast_value);
    EEPROM.commit();

    current_state = MENU;
    consume_encoder_button();
  } else if ((int32_t)encoder.getCount() != 0) {
      menu_change_contrast_current_value += encoder.getCount();
      if (menu_change_contrast_current_value > 127) {
        if ((int32_t)encoder.getCount() > 0) {
          menu_change_contrast_current_value = 127;
        } else {
          menu_change_contrast_current_value = 0;
        }
      }
      encoder.setCount(0);
      lcd.setContrast(menu_change_contrast_current_value);
    }
  
  // draw the config screen
  lcd.clear();
  lcd.draw(CONTRAST_ADJUSTMENT_GRADIENT,
           sizeof(CONTRAST_ADJUSTMENT_GRADIENT) / sizeof(CONTRAST_ADJUSTMENT_GRADIENT[0]),
           true);
  // draw the current value at the x-middle of the screen and take numbers >100 and >10 into account
  uint8_t x_pos = 35;
  if (menu_change_contrast_current_value < 100) {
    x_pos += 5;
  }
  if (menu_change_contrast_current_value < 10) {
    x_pos += 5;
  }
  lcd.setCursor(7, 4);
  lcd.print("Current Value:");
  lcd.setCursor(x_pos, 5);
  lcd.print(menu_change_contrast_current_value);
  delay(TIME_BETWEEN_FRAMES);
}
